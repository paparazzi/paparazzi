/*
 * Copyright (C) Gautier Hattenberger <gautier.hattenberger@enac.fr>
 *
 * This file is part of paparazzi
 *
 * paparazzi is free software; you can redistribute it and/or modify
 * it under the terms of the GNU General Public License as published by
 * the Free Software Foundation; either version 2, or (at your option)
 * any later version.
 *
 * paparazzi is distributed in the hope that it will be useful,
 * but WITHOUT ANY WARRANTY; without even the implied warranty of
 * MERCHANTABILITY or FITNESS FOR A PARTICULAR PURPOSE.  See the
 * GNU General Public License for more details.
 *
 * You should have received a copy of the GNU General Public License
 * along with paparazzi; see the file COPYING.  If not, see
 * <http://www.gnu.org/licenses/>.
 */
/**
 * @file "modules/range_finder/teraranger_one.c"
 * @author Gautier Hattenberger <gautier.hattenberger@enac.fr>
 * Driver for the TeraRanger One range finder (I2C)
 */

#include "modules/range_finder/teraranger_one.h"
#include "mcu_periph/i2c.h"
#include "modules/core/abi.h"
#include "modules/datalink/downlink.h"

// check if I2C device is selected
#ifndef TERARANGER_ONE_I2C_DEV
#error TERARANGER_ONE_I2C_DEV needs to be defined
#endif
PRINT_CONFIG_VAR(TERARANGER_ONE_I2C_DEV)

// default base address on 8 bits
#ifndef TERARANGER_ONE_I2C_ADDR
#define TERARANGER_ONE_I2C_ADDR 0x60
#endif

// add an offset to the measurments (in meters)
#ifndef TERARANGER_ONE_OFFSET
#define TERARANGER_ONE_OFFSET 0.f
#endif

// send AGL data over ABI
#ifndef USE_TERARANGER_ONE_AGL
#define USE_TERARANGER_ONE_AGL TRUE
#endif

// CRC8 table used to check data validity
static const uint8_t crc_table[] = {
  0x00, 0x07, 0x0e, 0x09, 0x1c, 0x1b, 0x12, 0x15, 0x38, 0x3f, 0x36, 0x31, 0x24, 0x23,
  0x2a, 0x2d, 0x70, 0x77, 0x7e, 0x79, 0x6c, 0x6b, 0x62, 0x65, 0x48, 0x4f, 0x46, 0x41,
  0x54, 0x53, 0x5a, 0x5d, 0xe0, 0xe7, 0xee, 0xe9, 0xfc, 0xfb, 0xf2, 0xf5, 0xd8, 0xdf,
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  0xfa, 0xfd, 0xf4, 0xf3
};

// CRC check function
static uint8_t teraranger_crc8(uint8_t *p, uint8_t len)
{
  uint16_t i;
  uint16_t crc = 0x0;

  while (len--)
  {
    i = (crc ^ *p++) & 0xFF;
    crc = (crc_table[i] ^ (crc << 8)) & 0xFF;
  }
  return crc & 0xFF;
}

// data stucture
struct TeraRanger teraranger;

// private data
struct i2c_transaction teraranger_i2c_trans;

void teraranger_init(void)
{
  teraranger.raw = 0;
  teraranger.dist = 0.f;
  teraranger.offset = TERARANGER_ONE_OFFSET;
  teraranger.data_available = false;

  teraranger_i2c_trans.status = I2CTransDone;
}

// data are available in continous reading
void teraranger_periodic(void)
{
  // next reading
  if (teraranger_i2c_trans.status == I2CTransDone) {
    i2c_receive(&TERARANGER_ONE_I2C_DEV, &teraranger_i2c_trans, TERARANGER_ONE_I2C_ADDR, 3);
  }
}

void teraranger_event(void)
{
  if (teraranger_i2c_trans.status == I2CTransSuccess) {
    // check if CRC is valid
    if (teraranger_crc8((uint8_t*)teraranger_i2c_trans.buf, 2) == teraranger_i2c_trans.buf[2]) {
      // raw value
      teraranger.raw =
        ((uint16_t)(teraranger_i2c_trans.buf[0]) << 8) |
        (uint16_t)(teraranger_i2c_trans.buf[1]);
      // check if data is within ranges
      if (teraranger.raw != 0) {
        teraranger.dist = (float)teraranger.raw / 1000.f + teraranger.offset;
        teraranger.data_available = true;
#if USE_TERARANGER_ONE_AGL
        uint32_t now_ts = get_sys_time_usec();
        AbiSendMsgAGL(AGL_TERARANGER_ONE_ID, now_ts, teraranger.dist);
#endif
      } else {
        // data are not valid any more
        teraranger.data_available = false;
      }
    }
    teraranger_i2c_trans.status = I2CTransDone;
  } else if (teraranger_i2c_trans.status == I2CTransFailed) {
    // retry if failed
    teraranger_i2c_trans.status = I2CTransDone;
  }
}

void teraranger_downlink(void)
{
  DOWNLINK_SEND_SONAR(DefaultChannel, DefaultDevice, &teraranger.raw, &teraranger.dist);
}

